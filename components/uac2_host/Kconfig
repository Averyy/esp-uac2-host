## components/uac2_host/Kconfig
```kconfig
menu "UAC2 Host Driver"

    config UAC2_NUM_ISOC_URBS
        int "Number of isochronous URBs kept in flight"
        default 3
        range 2 8
        help
            Number of isochronous transfer URBs kept in flight simultaneously.
            More URBs reduce the chance of underrun but use more memory.

    config UAC2_NUM_PACKETS_PER_URB
        int "Number of isochronous packets per URB"
        default 3
        range 1 8
        help
            Number of 1ms isochronous packets bundled into each URB.
            Higher values increase the resubmission margin (URBs * packets ms)
            at the cost of latency and memory. With the default 3 URBs and
            3 packets/URB, the HCD pipeline is 9ms — enough to absorb WiFi
            power-save wakeups and task scheduling jitter.

    config UAC2_CTRL_XFER_TIMEOUT_MS
        int "Control transfer timeout (ms)"
        default 5000
        range 1000 30000
        help
            Timeout for USB control transfers (SET_CUR, GET_CUR, GET_RANGE, etc.).

    config UAC2_CTRL_XFER_MAX_SIZE
        int "Max control transfer data size (bytes)"
        default 256
        range 64 1024
        help
            Maximum data payload for class-specific control transfers
            (GET_CUR, GET_RANGE, SET_CUR). Increase if your device returns
            large GET_RANGE responses (e.g., many sample rate triplets).
            Note: config descriptor fetching uses USB_HOST_CONTROL_TRANSFER_MAX_SIZE,
            not this setting.

    config UAC2_MAX_CONSECUTIVE_ERRORS
        int "Max consecutive transfer errors before stopping"
        default 10
        range 1 100
        help
            Stop URB re-submission after this many consecutive isochronous
            transfer errors.

endmenu
```

## components/usb_host_uac2/Kconfig
```kconfig
menu "UAC2 Host Driver"

    config UAC2_NUM_ISOC_URBS
        int "Number of isochronous URBs kept in flight"
        default 3
        range 2 8
        help
            Number of isochronous transfer URBs kept in flight simultaneously.
            More URBs reduce the chance of underrun but use more memory.

    config UAC2_NUM_PACKETS_PER_URB
        int "Number of isochronous packets per URB"
        default 3
        range 1 8
        help
            Number of 1ms isochronous packets bundled into each URB.
            Higher values increase the resubmission margin (URBs * packets ms)
            at the cost of latency and memory. With the default 3 URBs and
            3 packets/URB, the HCD pipeline is 9ms — enough to absorb WiFi
            power-save wakeups and task scheduling jitter.

    config UAC2_CTRL_XFER_TIMEOUT_MS
        int "Control transfer timeout (ms)"
        default 5000
        range 1000 30000
        help
            Timeout for USB control transfers (SET_CUR, GET_CUR, GET_RANGE, etc.).

    config UAC2_CTRL_XFER_MAX_SIZE
        int "Max control transfer data size (bytes)"
        default 256
        range 194 1024
        help
            Maximum data payload for class-specific control transfers
            (GET_CUR, GET_RANGE, SET_CUR). The sample-rate GET_RANGE request
            asks for up to 16 triplets (2 + 16 * 12 = 194 bytes), so smaller
            values would make every sample-rate range query fail.
            Note: config descriptor fetching uses USB_HOST_CONTROL_TRANSFER_MAX_SIZE,
            not this setting.

    config UAC2_MAX_CONSECUTIVE_ERRORS
        int "Max consecutive transfer errors before stopping"
        default 10
        range 1 100
        help
            Stop URB re-submission after this many consecutive isochronous
            transfer errors.

    config UAC2_ALLOW_DUPLEX
        bool "Allow playback and capture streams at the same time (ESP32-S3)"
        default n
        help
            On ESP32-S3 the driver refuses to start a stream while one in the
            opposite direction runs, because the USB Host Library's FIFO
            presets cannot hold both: the PERIODIC_OUT bias leaves 128 bytes
            for IN packets. Enable this only if the application installs the
            USB Host Library with usb_host_config_t.fifo_settings_custom
            (ESP-IDF 5.5+ or the espressif/usb component) giving both the
            periodic TX FIFO and the RX FIFO room for the endpoints in use
            (see UAC2_HOST_DUPLEX_FIFO_* in uac2_host.h). Without that split
            the second stream's start fails with ESP_ERR_NOT_SUPPORTED when the
            host refuses its endpoint. No effect on other targets.

            The device must support playback and capture at the same time
            (verified on the miniDSP 2x4 HD).

    config UAC2_ALLOW_UNADVERTISED_RATES
        bool "Allow sample rates the device does not advertise"
        default n
        help
            By default uac2_host_device_start() and
            uac2_host_device_set_sample_rate() refuse a sample rate outside the
            ranges the device's clock source reports (ESP_ERR_NOT_SUPPORTED),
            because some devices acknowledge a rate they cannot run and then
            play silence. Enable for a device whose advertised ranges are
            incomplete: the rate is then sent with only a warning.

    config UAC2_STOP_STREAMS_ON_RESTART
        bool "Stop streams before esp_restart()"
        default n
        help
            uac2_host_install() registers an esp_restart() shutdown handler
            (one of ESP-IDF's five) that stops every started stream first, as
            stop() does, so the device sees alt 0 before the host goes away,
            the order Linux uses at shutdown. It takes about 10 ms per stream,
            but can hold the restart for seconds if the device stops
            answering. It does nothing when esp_restart() is called from the
            task that pumps driver events. Panics, watchdog resets and the
            reset pin skip it.

            Enable for a device that misbehaves when the host restarts
            mid-stream. The miniDSP 2x4 HD isn't known to need it:
            esp_restart() leaves the USB controller running, and its
            occasional silent state followed hardware resets, never a
            software restart.

endmenu
```

## components/usb_host_uac2/examples/basic_playback/sdkconfig.defaults
```kconfig
CONFIG_USB_HOST_CONTROL_TRANSFER_MAX_SIZE=512
CONFIG_USB_HOST_HW_BUFFER_BIAS_PERIODIC_OUT=y
```

## main/Kconfig.projbuild
```kconfig
menu "esp-uac2-host Test App"

config UAC2_TEST12_DURATION_SEC
    int "Test 12 duration (seconds)"
    range 0 3600
    default 3600
    help
        Duration for the long-running stability test in the boot harness.
        Set to 0 to skip Test 12 entirely during local smoke runs.

config UAC2_TEST_TONES_SUBWOOFER
    bool "Play test tones in the subwoofer range"
    default n
    help
        The harness plays 1 kHz tones (plus 440/880/750 Hz and 100-900 Hz
        cycles), which a subwoofer's low-pass filter removes. Enable for
        listening checks through a subwoofer: every tone moves to 30-110 Hz
        at -12 dBFS.

config UAC2_TEST_RESTART_SEC
    int "Restart the ESP32 this many seconds into Test 12 (0 = off)"
    range 0 3600
    default 0
    help
        Calls esp_restart() mid-stream, once per power-on (a boot after a
        software restart skips it); listen for the next boot's tones. With
        CONFIG_UAC2_STOP_STREAMS_ON_RESTART the driver stops the stream
        first. Keep it below CONFIG_UAC2_TEST12_DURATION_SEC.

config UAC2_DUPLEX_TEST_SEC
    int "Duplex streaming check duration (seconds)"
    range 5 3600
    default 30
    depends on UAC2_ALLOW_DUPLEX
    help
        How long the duplex live check plays and captures at the same time
        (builds with CONFIG_UAC2_ALLOW_DUPLEX only).

endmenu
```

## sdkconfig.defaults
```kconfig
CONFIG_IDF_TARGET="esp32s3"
CONFIG_USB_HOST_CONTROL_TRANSFER_MAX_SIZE=1024
CONFIG_USB_HOST_HW_BUFFER_BIAS_PERIODIC_OUT=y
```

## simulators/minidsp-2x4hd/main/Kconfig.projbuild
```kconfig
menu "miniDSP 2x4 HD Simulator"

config MINIDSP_SIM_NO_FEEDBACK_TEST_BUILD
    bool "Build reduced no-feedback test image"
    default n
    help
        Build a reduced-capability simulator image where both playback
        alternate settings omit their feedback endpoints and the capture
        streaming alt is removed. This exists only for host-side validation
        of the driver's no-feedback fractional-rate rejection path.

config MINIDSP_SIM_PLAYBACK_CHANNEL_ONLY_FU_TEST_BUILD
    bool "Build playback feature-unit channel-only test image"
    default n
    help
        Build a descriptor variant where the playback feature unit exposes
        mute and volume only on channels 1 and 2, while master channel 0
        advertises no playback controls. This exists only to validate the
        host's per-channel capability handling.

config MINIDSP_SIM_EP0_HANG_TEST_BUILD
    bool "Build control-transfer hang test image"
    default n
    help
        Same descriptors and behavior as the default image, except that the
        first GET CUR clock-valid request after boot is never answered (its
        data stage stays NAKed). 12 seconds later the simulator
        soft-disconnects for 1 second and reconnects, with the fault disarmed
        until the next reboot. This drives the host's control-timeout path:
        abandoned request, orphaned control URB on close, and its reclaim when
        the device goes away. Product string "miniDSP 2x4HD [sim ep0-hang]".

config MINIDSP_SIM_FEEDBACK_DRIFT_TEST_BUILD
    bool "Build feedback drift test image"
    default n
    help
        Same descriptors as the default image, but the explicit feedback
        reports 2 Hz above the nominal rate (about 42 ppm), like a device
        whose clock runs fast. The simulator's periodic PACKET SIZING CHECK
        then shows whether the host follows the feedback instead of sending
        the nominal rate. Product string "miniDSP 2x4HD [sim fb-drift]".

endmenu
```
